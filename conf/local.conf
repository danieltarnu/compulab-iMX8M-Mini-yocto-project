## conf/local.conf
```bitbake
MACHINE ??= 'ucm-imx8m-mini'
DISTRO ?= 'fsl-imx-xwayland'
PACKAGE_CLASSES ?= "package_rpm"
EXTRA_IMAGE_FEATURES ?= "debug-tweaks"
USER_CLASSES ?= "buildstats image-mklibs image-prelink"
PATCHRESOLVE = "noop"
BB_DISKMON_DIRS ??= "\
    STOPTASKS,${TMPDIR},1G,100K \
    STOPTASKS,${DL_DIR},1G,100K \
    STOPTASKS,${SSTATE_DIR},1G,100K \
    STOPTASKS,/tmp,100M,100K \
    ABORT,${TMPDIR},100M,1K \
    ABORT,${DL_DIR},100M,1K \
    ABORT,${SSTATE_DIR},100M,1K \
    ABORT,/tmp,10M,1K"
PACKAGECONFIG_append_pn-qemu-native = " sdl"
PACKAGECONFIG_append_pn-nativesdk-qemu = " sdl"
CONF_VERSION = "1"

DL_DIR ?= "${BSPDIR}/downloads/"
ACCEPT_FSL_EULA = "1"

CORE_IMAGE_EXTRA_INSTALL += " dhcp-client memtester cl-uboot cl-deploy cl-launcher bt-start cl-stest cl-camera u-boot-fw-utils imx-gpu-viv-demos htop iotop tmux iperf3 openssh"

IMAGE_FEATURES += " package-management ssh-server-openssh "
LICENSE_FLAGS_WHITELIST = "commercial"
PREFERRED_RPROVIDER_u-boot-fw-utils = "u-boot-fw-utils"
BBMASK += "meta-compulab/recipes-xfce"

# Users' Configurations
# Add Chromium
IMAGE_INSTALL_append = \
    "${@bb.utils.contains('DISTRO_FEATURES', 'wayland', ' chromium-ozone-wayland', \
        bb.utils.contains('DISTRO_FEATURES',     'x11', ' chromium-x11', \
                                                        '', d), d)}"

# PACKAGECONFIG_append_pn-qtbase = " gles2 dbus freetype glib release eglfs cups sql-sqlite sql-mysql fontconfig evdev iconv alsa openssl icu zlib libpng jpeg harfbuzz accessibility widgets libs"
# https://forum.qt.io/topic/85074/yocto-imx6-qt5-9-and-qtquick-extras/7
PACKAGECONFIG_append_pn-qtbase = " accessibility"

QML_PACKAGES = " \
    qt3d \
    qt3d-dev \
    qt3d-mkspecs \
	qt3d-qmlplugins \
	qt3d-tools \
    qtcharts \
    qtcharts-dev \
    qtcharts-mkspecs \
    qtconnectivity-dev \
    qtconnectivity-mkspecs \
    qtquickcontrols2 \
	qtquickcontrols \
    qtquickcontrols-qmlplugins \
    qtquickcontrols2 \
    qtquickcontrols2-qmlplugins \
    qtquickcontrols2-dev \
    qtquickcontrols2-mkspecs \
    qtdeclarative \
    qtdeclarative-dev \
    qtdeclarative-mkspecs \
	qtdeclarative-plugins \
	qtdeclarative-tools \
	qtdeclarative-qmlplugins \
    qtgraphicaleffects \
    qtgraphicaleffects-dev \
	qtgraphicaleffects-qmlplugins \		
	qtsvg \
	qtsvg-plugins \
	qtsensors \
	qtimageformats-plugins \
	qtsystems \
	qtsystems-tools \
	qtsystems-qmlplugins \
	qtscript \
	qtconnectivity-dev \
	qtconnectivity-mkspecs \
	qtconnectivity-qmlplugins \
	qtlocation-plugins \
	qtlocation-qmlplugins \
"

QT_WEBKIT = " \
	qtwebkit \
	qtwebkit-qmlplugins \
"
QT_MULTIMEDIA = " \
	qtmultimedia \
	qtmultimedia-plugins \
	qtmultimedia-qmlplugins \
"

GSTREAMER = " \
	gstreamer1.0 \
   	gstreamer1.0-libav \
   	gstreamer1.0-plugins-good \
   	gstreamer1.0-plugins-bad \
"

QT_TOOLS = " \
    qtbase \
    qtbase-dev \
    qtbase-mkspecs \
    qtbase-plugins \
    qtbase-tools \
"

QT_SAMPLES = " \
	qt3d-examples \
	qtmultimedia-examples \
	qtsystems-examples \
"

IMAGE_INSTALL_append += " \
	${QT_TOOLS} \
	${QML_PACKAGES} \
	${GSTREAMER} \
	${QT_MULTIMEDIA} \
"

SFTP_PACKAGE = " \
	openssh-sftp-server \
"

IMAGE_INSTALL_append += " \
	${SFTP_PACKAGE} \
"

MONO_BASIC_PACKAGES = " \
	mono \
"

MONO_FULL_PACKAGES = " \
	mono-upnp \
	dbus-sharp \
	dbus-sharp-glib \ 
	gtk-sharp \
	mono-helloworld \
	mono-xsp \
	monotools-server \
	taglib-sharp \
	fsharp \
	libgdiplus \ 
	mono-basic \
	mono-upnp \
"

IMAGE_INSTALL_append += " \
	${MONO_BASIC_PACKAGES} \
"

ADDITIONAL_PACKAGES = " \
	parted \
	zlib \
"

IMAGE_INSTALL_append += " \
	${ADDITIONAL_PACKAGES} \
"

ADDITIONAL_SECURITY_PACKAGES = " \
	xmlsec1 \
"

IMAGE_INSTALL_append += " \
	${ADDITIONAL_SECURITY_PACKAGES} \
"

BOOST_LIBRARY = " \
	boost \
"

IMAGE_INSTALL_append += " \
	${BOOST_LIBRARY} \
"

#.NET dependencies
CORE_IMAGE_EXTRA_INSTALL += " libunwind icu libcurl openssl "

#It is strongly recommended to use curl with OpenSSL backend.
PACKAGECONFIG_pn-curl = 'vers krb5 ssl zlib ipv6'

#Check curl recipe for comple set of options. For debugging you may also add
CORE_IMAGE_EXTRA_INSTALL += " curl "

PREFERRED_VERSION_dotnet-core = "3.1.0"
CORE_IMAGE_EXTRA_INSTALL  += " aspnet-core vsdbg "

# Add python 3
CORE_IMAGE_EXTRA_INSTALL += " python3 python3-pip git " 

PREFERRED_VERSION_gcc-cross-${TARGET_ARCH} ?= "8%"
```

## sources/meta-compulab-bsp/meta-desktop/conf/layer.conf
```bitbake
# We have a conf and classes directory, append to BBPATH
BBPATH .= ":${LAYERDIR}"

# We have a recipes directory containing .bb and .bbappend files, add to BBFILES
BBFILES += "${LAYERDIR}/recipes-*/*/*.bb \
            ${LAYERDIR}/recipes-*/*/*.bbappend"

BBFILE_COLLECTIONS += "compulab-desktop"
BBFILE_PATTERN_compulab-desktop := "^${LAYERDIR}/"
BBFILE_PRIORITY_compulab-desktop = "9"

BBMASK += "meta-compulab/recipes-browser/chromium/chromium_%.bbappend"
```

## sources/meta-compulab-bsp/meta-multimedia/conf/layer.conf
```bitbake
# We have a conf and classes directory, append to BBPATH
BBPATH .= ":${LAYERDIR}"

# We have a recipes directory containing .bb and .bbappend files, add to BBFILES
BBFILES += "${LAYERDIR}/recipes*/*/*.bb \
            ${LAYERDIR}/recipes*/*/*.bbappend"

BBFILE_COLLECTIONS += "compulab-multimedia"
BBFILE_PATTERN_compulab-multimedia := "^${LAYERDIR}/"
BBFILE_PRIORITY_compulab-multimedia = "9"
```

## sources/meta-compulab-bsp/meta-xfce/conf/layer.conf
```bitbake
# We have a conf and classes directory, append to BBPATH
BBPATH .= ":${LAYERDIR}"

# We have a recipes directory containing .bb and .bbappend files, add to BBFILES
BBFILES += "${LAYERDIR}/recipes*/*/*.bb \
            ${LAYERDIR}/recipes*/*/*.bbappend"

BBFILE_COLLECTIONS += "compulab-xfce"
BBFILE_PATTERN_compulab-xfce := "^${LAYERDIR}/"
BBFILE_PRIORITY_compulab-xfce = "9"
```

## sources/meta-compulab/conf/machine/cl-som-imx6.conf
```bitbake
#@TYPE: Machine
#@NAME: CompuLab CL-SOM-iMX6
#@SOC: i.MX6 Q
#@DESCRIPTION: Machine configuration for CompuLab CL-SOM-iMX6 machines
#@MAINTAINER: Valentin Raevsky <valentin@compulab.co.il>

require conf/machine/include/imx-base.inc
require conf/machine/include/tune-cortexa9.inc

SOC_FAMILY = "mx6:mx6q"
MACHINEOVERRIDES =. "mx6:mx6q:"

PREFERRED_PROVIDER_u_boot_cl-som-imx6 = "u-boot-compulab"
PREFERRED_PROVIDER_virtual/bootloader_cl-som-imx6 = "u-boot-compulab"
PREFERRED_PROVIDER_virtual/kernel_cl-som-imx6 = "linux-compulab"

do_rootfs[depends] += "u-boot-script-compulab:do_deploy"

BOOT_SCRIPTS = "boot.scr-${MACHINE}:boot.scr"

UBOOT_MACHINE ?= "cl_som_imx6_defconfig"

IMAGE_FSTYPES = "sdcard.xz tar.xz"

KERNEL_DEVICETREE = "imx6q-cl-som-imx6.dtb imx6qp-cl-som-imx6.dtb imx6qp-sbc-imx6.dtb imx6qp-sbc-imx6-dvi.dtb imx6qp-sbc-imx6-hdmi.dtb imx6q-sbc-imx6.dtb imx6q-sbc-imx6-dvi.dtb imx6q-sbc-imx6-hdmi.dtb imx6q-sbc-imx6-parallel.dtb imx6qp-sbc-imx6-parallel.dtb"

MACHINE_FEATURES += "pci wifi bluetooth alsa bluetooth serial usbhost wifi"

MACHINE_FIRMWARE_append_cl-som-imx6 += "firmware-imx-brcm"

SERIAL_CONSOLE = "115200 ttymxc3"
```

## sources/meta-compulab/conf/machine/cl-som-imx6ul.conf
```bitbake
#@TYPE: Machine
#@NAME: CompuLab CL-SOM-iMX6UL
#@SOC: i.MX6UL
#@DESCRIPTION: Machine configuration for CompuLab CL-SOM-iMX6UL machines
#@MAINTAINER: Valentin Raevsky <valentin@compulab.co.il>

include conf/machine/include/imx-base.inc
include conf/machine/include/tune-cortexa7.inc
include conf/machine/include/imx6ul-common.inc

SOC_FAMILY = "mx6ul"
MACHINEOVERRIDES =. "mx6:mx6ul:mx6ull:"

PREFERRED_PROVIDER_u_boot_cl-som-imx6ul = "u-boot-compulab"
PREFERRED_PROVIDER_virtual/bootloader_cl-som-imx6ul = "u-boot-compulab"
PREFERRED_PROVIDER_virtual/kernel_cl-som-imx6ul = "linux-compulab"

UBOOT_MACHINE ?= "cl_som_imx6ul_defconfig"

IMAGE_FSTYPES = "sdcard.xz tar.xz"

KERNEL_DEVICETREE = "imx6ul-cl-som-imx6ul.dtb imx6ul-cl-som-imx6ul-wilink.dtb imx6ul-sbc-imx6ul.dtb imx6ul-sbc-imx6ul-wilink.dtb"

MACHINE_FEATURES += "alsa bluetooth serial usbhost wifi"

MACHINE_FIRMWARE = "linux-firmware-wl18xx"

SERIAL_CONSOLE = "115200 ttymxc2"
```

## sources/meta-compulab/conf/machine/cl-som-imx7.conf
```bitbake
#@TYPE: Machine
#@NAME: CompuLab CL-SOM-iMX7
#@SOC: i.MX7D
#@DESCRIPTION: Machine configuration for CompuLab CL-SOM-iMX7 machines
#@MAINTAINER: Ilya Ledvich <ilya@compulab.co.il>

include conf/machine/include/imx-base.inc
include conf/machine/include/tune-cortexa7.inc

SOC_FAMILY = "mx7:mx7d"
MACHINEOVERRIDES =. "mx7:mx7d:"

PREFERRED_PROVIDER_u_boot_cl-som-imx7 = "u-boot-compulab"
PREFERRED_PROVIDER_virtual/bootloader_cl-som-imx7 = "u-boot-compulab"
PREFERRED_PROVIDER_virtual/kernel_cl-som-imx7 = "linux-compulab"

UBOOT_MACHINE ?= "cl-som-imx7_defconfig"

IMAGE_FSTYPES = "sdcard.xz tar.xz"

KERNEL_DEVICETREE =  "imx7d-cl-som-imx7.dtb"
KERNEL_DEVICETREE += "imx7d-sbc-imx7.dtb imx7d-sbc-imx7-m4.dtb imx7d-sbc-imx7-lvds.dtb"
KERNEL_DEVICETREE += "imx7d-sbc-iot-imx7.dtb imx7d-sbc-iot-imx7-rs485-hdx.dtb imx7d-sbc-iot-imx7-can.dtb"

MACHINE_FEATURES += "alsa bluetooth serial usbhost wifi pci"

XSERVER += "mesa-driver-swrast"

MACHINE_FIRMWARE = "linux-firmware-wl18xx \
			linux-firmware-iwlwifi-6000g2a-5 linux-firmware-iwlwifi-6000g2a-6 \
			linux-firmware-iwlwifi-6000g2b-5 linux-firmware-iwlwifi-6000g2b-6"

SERIAL_CONSOLE = "115200 ttymxc0"
```

## sources/meta-compulab/conf/machine/cm-fx6-evk.conf
```bitbake
#@TYPE: Machine
#@NAME: CompuLab CM-FX6
#@SOC: i.MX6 Q
#@DESCRIPTION: Machine configuration for CompuLab CM-FX6 machines
#@MAINTAINER: Valentin Raevsky <valentin@compulab.co.il>

require conf/machine/include/imx-base.inc
require conf/machine/include/tune-cortexa9.inc

SOC_FAMILY = "mx6:mx6q"
MACHINEOVERRIDES =. "mx6:mx6q:"

PREFERRED_PROVIDER_u_boot_cm-fx6-evk = "u-boot-compulab"
PREFERRED_PROVIDER_virtual/bootloader_cm-fx6-evk = "u-boot-compulab"
PREFERRED_PROVIDER_virtual/kernel_cm-fx6-evk = "linux-compulab"

do_rootfs[depends] += "u-boot-script-compulab:do_deploy"

BOOT_SCRIPTS = "boot.scr-${MACHINE}:boot.scr"

UBOOT_MACHINE ?= "cm_fx6_defconfig"

IMAGE_FSTYPES = "sdcard.xz tar.xz"

KERNEL_DEVICETREE = "imx6dl-cm-fx6.dtb imx6dl-sbc-fx6.dtb imx6dl-sbc-fx6-hdmi.dtb imx6dl-sbc-fx6m.dtb imx6dl-sbc-fx6-mipi.dtb imx6dl-sbc-fx6-parallel.dtb imx6q-cm-fx6.dtb imx6q-sbc-fx6-1-hdmi-2-ldb.dtb imx6q-sbc-fx6-1-ldb-2-hdmi.dtb imx6q-sbc-fx6-1-ldb-2-tft.dtb imx6q-sbc-fx6.dtb imx6q-sbc-fx6-hdmi.dtb imx6q-sbc-fx6-lcd-640x240-51.dtb imx6q-sbc-fx6-lcd-640x240-51-tft.dtb imx6q-sbc-fx6-ldb-640x240-51.dtb imx6q-sbc-fx6-ldb-640x240-51-tft.dtb imx6q-sbc-fx6-ldb-640x240-63.dtb imx6q-sbc-fx6-ldb-640x240-65.dtb imx6q-sbc-fx6-ldb-640x240-65-tft.dtb imx6q-sbc-fx6-ldb-800x480-60.dtb imx6q-sbc-fx6-ldb-800x480-60-tft.dtb imx6q-sbc-fx6m.dtb imx6q-sbc-fx6-mipi.dtb imx6q-sbc-fx6-parallel.dtb"
KERNEL_DEVICETREE += " imx6dl-cm-fx6-800.dtb imx6dl-sbc-fx6-800.dtb"

MACHINE_FEATURES += "pci wifi bluetooth alsa bluetooth serial usbhost wifi"

MACHINE_FIRMWARE_append_mx6 += "linux-firmware-sd8787"

SERIAL_CONSOLE = "115200 ttymxc3"
```

## sources/meta-compulab/recipes-bsp/u-boot/u-boot-compulab-2015.10/cl_som_imx6ul_defconfig
```kconfig
CONFIG_ARM=y
CONFIG_ARCH_MX6=y
CONFIG_TARGET_CL_SOM_IMX6UL=y
CONFIG_SPL=y
CONFIG_SYS_EXTRA_OPTIONS="IMX_CONFIG=arch/arm/imx-common/spl_sd.cfg,MX6UL,SPL"
CONFIG_SYS_PROMPT="CL-SOM-iMX6UL # "
CONFIG_CMD_BOOTZ=y
CONFIG_CMD_DHCP=y
CONFIG_CMD_I2C=y
CONFIG_CMD_NET=y
CONFIG_CMD_PING=y
CONFIG_CMD_SF=y
CONFIG_CMD_USB=y
CONFIG_SPI_FLASH=y
CONFIG_SPI_FLASH_ATMEL=y
CONFIG_SPI_FLASH_EON=y
CONFIG_SPI_FLASH_GIGADEVICE=y
CONFIG_SPI_FLASH_MACRONIX=y
CONFIG_SPI_FLASH_SPANSION=y
CONFIG_SPI_FLASH_STMICRO=y
CONFIG_SPI_FLASH_SST=y
CONFIG_SPI_FLASH_WINBOND=y
```
